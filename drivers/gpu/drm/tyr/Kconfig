## drivers/gpu/drm/tyr/Kconfig
```kconfig
# SPDX-License-Identifier: GPL-2.0 or MIT

config DRM_TYR_STATIC_DEPS
	bool
	select DRM_GEM_SHMEM_HELPER
	select DRM_GPUVM
	select DRM_SCHED
	help
	  Ensure required DRM infrastructure is built-in when enabling Tyr
	  even if Tyr is =m

config DRM_TYR
	tristate "Tyr (Rust DRM support for ARM Mali CSF-based GPUs)"
	depends on DRM=y
	depends on RUST
	depends on ARM || ARM64 || COMPILE_TEST
	depends on !GENERIC_ATOMIC64  # for IOMMU_IO_PGTABLE_LPAE
	depends on COMMON_CLK
	depends on MMU
	select DRM_TYR_STATIC_DEPS
	select IOMMU_IO_PGTABLE_LPAE
	select RUST_DRM_GEM_SHMEM_HELPER
	select RUST_FW_LOADER_ABSTRACTIONS
	select DRM_PANTHOR_TRACE
	depends on IOMMU_SUPPORT
	default n
	help
	  Rust DRM driver for ARM Mali CSF-based GPUs.

	  This driver is for Mali (or Immortalis) Valhall Gxxx GPUs.

	  Note that the Mali-G68 and Mali-G78, while Valhall architecture, will
	  be supported with the panfrost driver as they are not CSF GPUs.

	  If M is selected, the module will be called tyr. This driver is work
	  in progress and may not be functional.
```
